## boards/nrf52840_mdk_dongle/Kconfig.nrf52840_mdk_dongle
```kconfig
#
# Copyright (c) 2026 The ZMK Contributors
#
# SPDX-License-Identifier: MIT
#

config BOARD_NRF52840_MDK_DONGLE
    select SOC_NRF52840_QIAA
    select ZMK_BOARD_COMPAT if BOARD_NRF52840_MDK_DONGLE
```

## dts/bindings/zmk,behavior-esc-to-base.yaml
```yaml
# Copyright (c) 2026
# SPDX-License-Identifier: MIT

description: Send Escape and force the default layer (cancels any locked layer)

compatible: "zmk,behavior-esc-to-base"

include: zero_param.yaml
```
